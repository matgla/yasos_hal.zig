## KConfig
```kconfig
# KConfig
#
# Copyright (C) 2025 Mateusz Stadnik <matgla@live.com>
#
# This program is free software: you can redistribute it and/or
# modify it under the terms of the GNU General Public License
# as published by the Free Software Foundation, either version
# 3 of the License, or (at your option) any later version.
#
# This program is distributed in the hope that it will be
# useful, but WITHOUT ANY WARRANTY; without even the implied
# warranty of MERCHANTABILITY or FITNESS FOR A PARTICULAR
# PURPOSE. See the GNU General Public License for more details.
#
# You should have received a copy of the GNU General
# Public License along with this program. If not, see
# <https://www.gnu.org/licenses/>.
#

rsource "./boards/KConfig"
rsource "./source/KConfig"

menu "Compile options"

config LINKER_SCRIPT_PATH
    string "Linker script"
    help 
        Path to custom linker script for executable linking

config BUNDLE_COMPILER_RT 
    bool "Bundle compiler RT"
    help 
        Bundle compiler RT. Compiler RT may not be compatible with GCC based environment, i.e. for newlib nano
endmenu
```

## boards/host/KConfig
```kconfig
# KConfig
#
# Copyright (C) 2025 Mateusz Stadnik <matgla@live.com>
#
# This program is free software: you can redistribute it and/or
# modify it under the terms of the GNU General Public License
# as published by the Free Software Foundation, either version
# 3 of the License, or (at your option) any later version.
#
# This program is distributed in the hope that it will be
# useful, but WITHOUT ANY WARRANTY; without even the implied
# warranty of MERCHANTABILITY or FITNESS FOR A PARTICULAR
# PURPOSE. See the GNU General Public License for more details.
#
# You should have received a copy of the GNU General
# Public License along with this program. If not, see
# <https://www.gnu.org/licenses/>.
#

config BOARD_HOST_DISCARD_IN_CONF
  bool "HOST"

config BOARD
  def_string "host" if BOARD_HOST_DISCARD_IN_CONF
  depends on BOARD_HOST_DISCARD_IN_CONF 

if BOARD_HOST_DISCARD_IN_CONF 
  choice CHOICE_CPU
    default CPU_HOST 
  endchoice

  config BUILD_BUNDLE_COMPILER_RT
    default y
endif
```

## boards/raspberry_pico/KConfig
```kconfig
# KConfig
#
# Copyright (C) 2025 Mateusz Stadnik <matgla@live.com>
#
# This program is free software: you can redistribute it and/or
# modify it under the terms of the GNU General Public License
# as published by the Free Software Foundation, either version
# 3 of the License, or (at your option) any later version.
#
# This program is distributed in the hope that it will be
# useful, but WITHOUT ANY WARRANTY; without even the implied
# warranty of MERCHANTABILITY or FITNESS FOR A PARTICULAR
# PURPOSE. See the GNU General Public License for more details.
#
# You should have received a copy of the GNU General
# Public License along with this program. If not, see
# <https://www.gnu.org/licenses/>.
#

config BOARD_RASPBERRY_PICO
  bool "Raspberry Pico"

config BOARD
  def_string "raspberry_pico" if BOARD_RASPBERRY_PICO
  depends on BOARD_RASPBERRY_PICO 

if BOARD_RASPBERRY_PICO
  config FIRMWARE_IN_FLASH 
    default y

  choice CHOICE_CPU
    default CPU_RP2040
  endchoice

  config LINKER_SCRIPT_PATH
    default "${hal_root}/source/cortex-m0plus/raspberry/rp2040/linker_script.ld" 

  config BUNDLE_COMPILER_RT
    default n 

  config FLASH_MEMORY_ADDRESS
    default "0x10000000"
  
  config FLASH_MEMORY_SIZE
    default "2MB"

endif
```

## boards/raspberry_pico_2/KConfig
```kconfig
# KConfig
#
# Copyright (C) 2025 Mateusz Stadnik <matgla@live.com>
#
# This program is free software: you can redistribute it and/or
# modify it under the terms of the GNU General Public License
# as published by the Free Software Foundation, either version
# 3 of the License, or (at your option) any later version.
#
# This program is distributed in the hope that it will be
# useful, but WITHOUT ANY WARRANTY; without even the implied
# warranty of MERCHANTABILITY or FITNESS FOR A PARTICULAR
# PURPOSE. See the GNU General Public License for more details.
#
# You should have received a copy of the GNU General
# Public License along with this program. If not, see
# <https://www.gnu.org/licenses/>.
#

config BOARD_RASPBERRY_PICO_2
  bool "Raspberry Pico 2"

config BOARD
  def_string "raspberry_pico_2" if BOARD_RASPBERRY_PICO_2
  depends on BOARD_RASPBERRY_PICO_2

if BOARD_RASPBERRY_PICO_2
  choice CHOICE_CPU
    default CPU_RP2350
  endchoice

  config LINKER_SCRIPT_PATH
    default "${hal_root}/source/cortex-m33/raspberry/rp2350/linker_script.ld" 

  config BUNDLE_COMPILER_RT
    default n 

  config FLASH_MEMORY_ADDRESS
    default "0x10000000"
  
  config FLASH_MEMORY_SIZE
    default "2MB"
endif
```

## source/cortex-m33/raspberry/rp2350/KConfig
```kconfig
# KConfig
#
# Copyright (C) 2025 Mateusz Stadnik <matgla@live.com>
#
# This program is free software: you can redistribute it and/or
# modify it under the terms of the GNU General Public License
# as published by the Free Software Foundation, either version
# 3 of the License, or (at your option) any later version.
#
# This program is distributed in the hope that it will be
# useful, but WITHOUT ANY WARRANTY; without even the implied
# warranty of MERCHANTABILITY or FITNESS FOR A PARTICULAR
# PURPOSE. See the GNU General Public License for more details.
#
# You should have received a copy of the GNU General
# Public License along with this program. If not, see
# <https://www.gnu.org/licenses/>.
#

config CPU_RP2350
  bool "RP2350"

config CPU
  def_string "rp2350" if CPU_RP2350
  depends on CPU_RP2350

if CPU_RP2350
  choice CHOICE_CPU_ARCHITECTURE
    default CPU_ARCH_CORTEX_M33
  endchoice

  choice CHOICE_CPU_FAMILY 
    default CPU_FAMILY_RASPBERRY 
  endchoice
endif 
```
